## main/Kconfig.projbuild
```kconfig
menu "Example Configuration"

config WIFI_SSID
    string "WiFi SSID"
	default "eduroam"
	help
		SSID (network name) for the example to connect to.
		

config WIFI_IDENTITY
    string "WiFi Identity"
	default "mylogin@avans.nl"
	help
		WiFi Identity for eduroam

		Can be left blank if you don't want to connect to eduroam

config WIFI_PASSWORD
    string "WiFi Password"
	default "mypassword"
	help
		WiFi password (WPA or WPA2) for the example to use.

		Can be left blank if the network has no security set.

endmenu
```
